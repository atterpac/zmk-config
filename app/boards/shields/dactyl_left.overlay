#include "dactyl.dtsi" // Notice that the main dtsi files are included in the overlay.

&kscan0 {
    col-gpios
        = <&gpio1 06 GPIO_ACTIVE_HIGH> // col1 in the schematic
        , <&gpio1 04 GPIO_ACTIVE_HIGH> // col2 in the schematic
        , <&gpio0 11 GPIO_ACTIVE_HIGH> // col3 in the schematic
        , <&gpio1 00 GPIO_ACTIVE_HIGH> // col4 in the schematic
        , <&gpio0 24 GPIO_ACTIVE_HIGH> // col5 in the schematic
        , <&gpio0 22 GPIO_ACTIVE_HIGH> // col6 in the schematic
        ;
};
